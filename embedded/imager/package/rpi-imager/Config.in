## embedded/imager/package/rpi-imager/Config.in
```kconfig
config BR2_PACKAGE_RPI_IMAGER
	bool "rpi-imager"
	depends on BR2_PACKAGE_QT6
	select BR2_PACKAGE_QT6BASE
	select BR2_PACKAGE_QT6SVG
	select BR2_PACKAGE_QT6QUICKCONTROLS2
	select BR2_PACKAGE_LIBCURL
	select BR2_PACKAGE_LIBARCHIVE
	select BR2_PACKAGE_ZLIB
	select BR2_PACKAGE_XZ
	select BR2_PACKAGE_ZSTD
	select BR2_PACKAGE_NETTLE
	select BR2_PACKAGE_GNUTLS
	select BR2_PACKAGE_LIBDRM
	select BR2_PACKAGE_LIBIDN2
	help
	  Raspberry Pi Imager - A GUI tool for writing OS images to SD cards.

	  https://github.com/raspberrypi/rpi-imager
```
